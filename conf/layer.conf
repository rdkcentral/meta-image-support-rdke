## conf/layer.conf
```bitbake
# We have a conf directory, add to BBPATH
BBPATH .= ":${LAYERDIR}"

BBFILE_COLLECTIONS += "rdke-image-support"
BBFILE_PATTERN_rdke-image-support = "^${LAYERDIR}/"
BBFILE_PRIORITY_rdke-image-support = "6"

LAYERDEPENDS_rdke-image-support = "core"
LAYERSERIES_COMPAT_rdke-image-support = "dunfell kirkstone"

# Include multiconfig and default setup configurations
require conf/include/multiconfig.inc
require conf/include/defaultsetup.conf
```
